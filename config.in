## configs/Kconfig
```kconfig
# Kconfig file for LVGL v9.4.0 and LVGL v8.4.0
choice BR2_PACKAGE_LVGL_VERSION
	prompt "LVGL Version."
	default BR2_PACKAGE_LVGL_VERSION_8
	help
	  Select LVGL version.

	config BR2_PACKAGE_LVGL_VERSION_8
		bool "v8.x"
	config BR2_PACKAGE_LVGL_VERSION_9
		bool "v9.x"
endchoice

# source "configs/Config.options"
if BR2_PACKAGE_LVGL_VERSION_8
	source "configs/lvgl8/lvgl/Config.in"
	source "configs/lvgl8/lv_drivers/Config.in"
endif

if BR2_PACKAGE_LVGL_VERSION_9
	source "configs/lvgl9/Config.in"
endif
```
